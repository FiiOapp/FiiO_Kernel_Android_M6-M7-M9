/*
 * Copyright (c) 2016 Samsung Electronics Co., Ltd.
 *		http://www.samsung.com
 *
 * This program is free software; you can redistribute it and/or modify
 * it under the terms of the GNU General Public License version 2 as
 * published by the Free Software Foundation.
*/

#include "exynos_gpio_config_macros.dtsi"

// GPA0 GPA1 GPA2 GPQ0 ETC0 ECT1
/* Alive register doesn't have sleep status, therefore, Do not set sleep status */

// GPB0 GPB1

// GPF0 GPF2 GPF3 GPF4
&pinctrl_2 {
	pinctrl-names = "sleep";
	pinctrl-0 = <&sleep2>;
	sleep2:sleep-state {
		PIN_SLP(gpf0-0, INPUT, DOWN);	/* EMMC_CLK */
		PIN_SLP(gpf0-1, INPUT, DOWN);	/* EMMC_CMD */
		PIN_SLP(gpf0-2, INPUT, DOWN);	/* EMMC_RDQS */
		PIN_SLP(gpf0-3, PREV, NONE);	/* EMMC_NRESET */
		PIN_SLP(gpf2-0, INPUT, DOWN);	/* EMMC_D0*/
		PIN_SLP(gpf2-1, INPUT, DOWN);	/* EMMC_D1 */
		PIN_SLP(gpf2-2, INPUT, DOWN);	/* EMMC_D2 */
		PIN_SLP(gpf2-3, INPUT, DOWN);	/* EMMC_D3 */
		PIN_SLP(gpf2-4, INPUT, DOWN);	/* EMMC_D4 */
		PIN_SLP(gpf2-5, INPUT, DOWN);	/* EMMC_D5 */
		PIN_SLP(gpf2-6, INPUT, DOWN);	/* EMMC_D6 */
		PIN_SLP(gpf2-7, INPUT, DOWN);	/* EMMC_D7 */
		PIN_SLP(gpf3-0, INPUT, DOWN);	/* XMMC1_CLK */
		PIN_SLP(gpf3-1, INPUT, DOWN);	/* XMMC1_CMD */
		PIN_SLP(gpf3-2, INPUT, DOWN);	/* XMMC1_D0 */
		PIN_SLP(gpf3-3, INPUT, DOWN);	/* XMMC1_D1 */
		PIN_SLP(gpf3-4, INPUT, DOWN);	/* XMMC1_D2 */
		PIN_SLP(gpf3-5, INPUT, DOWN);	/* XMMC1_D3 */
		PIN_SLP(gpf4-0, INPUT, DOWN);	/* TFLASH_CLK */
		PIN_SLP(gpf4-1, INPUT, DOWN);	/* TFLASH_CMD */
		PIN_SLP(gpf4-2, INPUT, DOWN);	/* TFLASH_D0 */
		PIN_SLP(gpf4-3, INPUT, DOWN);	/* TFLASH_D1 */
		PIN_SLP(gpf4-4, INPUT, DOWN);	/* TFLASH_D2 */
		PIN_SLP(gpf4-5, INPUT, DOWN);	/* TFLASH_D3 */
	};
};

// GPP0 GPP1 GPP2 GPP3 GPP4 GPP5 GPP6 GPP7 GPP8 GPG1 GPG2 GPG3 GPG4
// GPC0 GPC1 GPC2
&pinctrl_3 {
	pinctrl-names = "sleep";
	pinctrl-0 = <&sleep3>;
	sleep3:sleep-state {
		PIN_SLP(gpp0-0, INPUT, DOWN);	/* HUB_UART_RXD */
		PIN_SLP(gpp0-1, INPUT, DOWN);	/* HUB_UART_TXD */
		PIN_SLP(gpp0-2, INPUT, DOWN);	/* HUB_UART_CTSN */
		PIN_SLP(gpp0-3, INPUT, DOWN);	/* HUB_UART_RTSN */
		PIN_SLP(gpg0-0, INPUT, DOWN);	/* PMIC_EMMC_EN */
		PIN_SLP(gpg0-1, INPUT, DOWN);	/* PWM_TOUT0 */
		PIN_SLP(gpg0-2, INPUT, DOWN);	/* USB_VBUS_5.0V */
		PIN_SLP(gpp1-0, INPUT, NONE);	/* FG_I2C0_SDA */
		PIN_SLP(gpp1-1, INPUT, NONE);	/* FG_I2C0_SCL */
		PIN_SLP(gpp1-2, INPUT, NONE);	/* IF_PMIC_I2C1_SDA */
		PIN_SLP(gpp1-3, INPUT, NONE);	/* IF_PMIC_I2C1_SCL */
		PIN_SLP(gpp2-0, INPUT, DOWN);	/* NFC_I2C2_SDA */
		PIN_SLP(gpp2-1, INPUT, DOWN);	/* NFC_I2C2_SCL */
		PIN_SLP(gpp2-2, PREV, NONE);	/* NFC_PD */
		PIN_SLP(gpp2-3, PREV, NONE);	/* NFC_CLKREQ */
		PIN_SLP(gpp3-0, INPUT, NONE);	/* AMP_I2C3_SDA */
		PIN_SLP(gpp3-1, INPUT, NONE);	/* AMP_I2C3_SCL */
		PIN_SLP(gpp3-2, PREV, NONE);	/* NFC_WAKE */
		PIN_SLP(gpp4-0, INPUT, NONE);	/* TSP_I2C4_SDA */
		PIN_SLP(gpp4-1, INPUT, NONE);	/* TSP_I2C4_SCL */
		PIN_SLP(gpp4-2, INPUT, NONE);	/* TOUCH_KEY_I2C5_SDA */
		PIN_SLP(gpp4-3, INPUT, NONE);	/* TOUCH_KEY_I2C5_SCL */
		PIN_SLP(gpp4-4, INPUT, NONE);	/* HUB/PMIC_I2C6_SDA */
		PIN_SLP(gpp4-5, INPUT, NONE);	/* HUB/PMIC_I2C6_SCL */
		PIN_SLP(gpp5-0, INPUT, DOWN);	/* NFC_XSPI_CLK */
		PIN_SLP(gpp5-1, INPUT, DOWN);	/* NFC_XSPI_NSS */
		PIN_SLP(gpp5-2, INPUT, DOWN);	/* NFC_XSPI_MISO */
		PIN_SLP(gpp5-3, INPUT, DOWN);	/* NFC_XSPI_MOSI */
		PIN_SLP(gpp6-0, INPUT, DOWN);	/* FPT_SPI1_CLK */
		PIN_SLP(gpp6-1, INPUT, DOWN);	/* FPT_SPI1_CSN */
		PIN_SLP(gpp6-2, INPUT, DOWN);	/* FPT_SPI1_MISO */
		PIN_SLP(gpp6-3, INPUT, DOWN);	/* FPT_SPI1_MOSI */
		PIN_SLP(gpp6-4, PREV, NONE);	/* NFC_TVDDI_EN */
		PIN_SLP(gpp7-0, INPUT, DOWN);	/* HUB_SPI_MISO */
		PIN_SLP(gpp7-1, INPUT, DOWN);	/* HUB_SPI_MOSI */
		PIN_SLP(gpp8-0, INPUT, DOWN);	/* HUB_SPI_CS_N */
		PIN_SLP(gpp8-1, INPUT, DOWN);	/* HUB_SPI_CLK */
		PIN_SLP(gpg1-0, PREV, NONE);	/* NFC_PVDD_1V8_EN */
		PIN_SLP(gpg1-1, PREV, NONE);	/* NFC_SIMVDD2_EXT_EN */
		PIN_SLP(gpg1-2, PREV, NONE);	/* PMIC_WRSTBI */
		PIN_SLP(gpg1-3, PREV, NONE);	/* FM_LNA_EN */
		PIN_SLP(gpg1-4, INPUT, DOWN);	/* N22327572 */
		PIN_SLP(gpg1-5, INPUT, DOWN);	/* LCD_GPIO1/FG_INTB */
		PIN_SLP(gpg1-6, INPUT, DOWN);	/* PCD_INT */
		PIN_SLP(gpg1-7, PREV, NONE);	/* MLCD_RSTB */
		PIN_SLP(gpg2-0, INPUT, DOWN);	/* CAM_FLASH_ON */
		PIN_SLP(gpg2-1, INPUT, DOWN);	/* CAM_TORCH_ON */
		PIN_SLP(gpg2-2, INPUT, DOWN);	/* DISP_BUCK_EN */
		PIN_SLP(gpg2-3, INPUT, DOWN);	/* AP_PWR_EN */
		PIN_SLP(gpg2-4, INPUT, DOWN);	/* BUCK2EN */
		PIN_SLP(gpg2-5, INPUT, DOWN);	/* TSP_AVDD_3V3_EN */
		PIN_SLP(gpg2-6, INPUT, DOWN);	/* VT_CAM_ID */
		PIN_SLP(gpg2-7, INPUT, DOWN);	/* VT_CAM_STBY */
		PIN_SLP(gpg3-0, INPUT, DOWN);	/* N22328088 */
		PIN_SLP(gpg3-1, INPUT, DOWN);	/* N22329054 */
		PIN_SLP(gpg3-2, PREV, NONE);	/* FPT_NRESET */
		PIN_SLP(gpg3-3, INPUT, NONE);	/* HUB_RST_N */
		PIN_SLP(gpg3-4, INPUT, DOWN);	/* HUB_GPIO25 */
		PIN_SLP(gpg3-5, INPUT, NONE);	/* HUB_GPIO36 */
		PIN_SLP(gpg3-6, INPUT, DOWN);	/* HW_REV0 */
		PIN_SLP(gpg3-7, INPUT, DOWN);	/* HW_REV1 */
		PIN_SLP(gpg4-0, INPUT, DOWN);	/* HW_REV2 */
		PIN_SLP(gpg4-1, INPUT, NONE);	/* HW_REV3 */
		PIN_SLP(gpc0-0, INPUT, DOWN);	/* MAIN_CAM_MCLK */
		PIN_SLP(gpc0-1, INPUT, DOWN);	/* VT_CAM_MCLK */
		PIN_SLP(gpc0-2, INPUT, DOWN);	/* O */
		PIN_SLP(gpc0-3, INPUT, DOWN);	/* N22328695 */
		PIN_SLP(gpc1-0, INPUT, NONE);	/* MAIN_CAM_SDA_1.8V */
		PIN_SLP(gpc1-1, INPUT, NONE);	/* MAIN_CAM_SCL_1.8V */
		PIN_SLP(gpc1-2, INPUT, NONE);	/* VT_CAM_SDA_1.8V */
		PIN_SLP(gpc1-3, INPUT, NONE);	/* VT_CAM_SCL_1.8V */
		PIN_SLP(gpc1-4, INPUT, NONE);	/* SUB_PMIC_SDA_1.8V */
		PIN_SLP(gpc1-5, INPUT, NONE);	/* SUB_PMIC_SCL_1.8V */
		PIN_SLP(gpc1-6, INPUT, DOWN);	/* O */
		PIN_SLP(gpc1-7, INPUT, DOWN);	/* O */
		PIN_SLP(gpc2-0, INPUT, DOWN);	/* O */
		PIN_SLP(gpc2-1, INPUT, DOWN);	/* O */
		PIN_SLP(gpc2-2, INPUT, DOWN);	/* O */
		PIN_SLP(gpc2-3, INPUT, DOWN);	/* O */
		PIN_SLP(gpc2-4, PREV, NONE);	/* LED_GREEN_EN */
		PIN_SLP(gpc2-5, PREV, NONE);	/* LED_BLUE_EN */
		PIN_SLP(gpc2-6, PREV, NONE);	/* LED_RED_EN */
		PIN_SLP(gpc2-7, INPUT, DOWN);	/* O */
	};
};
